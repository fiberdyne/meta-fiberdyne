## conf/layer.conf
```bitbake
# This builds the Fiberdyne DSP Library as a kernel module

# We have a conf and classes directory, add to BBPATH
BBPATH .= ":${LAYERDIR}"

# We have recipes-* directories, add to BBFILES
# .bb files point to the actual recipes while the .bbappend files point to files where we're 'appending' stuff
# to existing reciepes
BBFILES += "${LAYERDIR}/recipes-*/*/*.bb" 
#            ${LAYERDIR}/recipes-*/*/*.bbappend

BBFILE_COLLECTIONS += "fiberdyne"
BBFILE_PATTERN_fiberdyne = "^${LAYERDIR}/"
BBFILE_PRIORITY_fiberdyne = "5"
LAYERVERSION_fiberdyne = "2"
```
